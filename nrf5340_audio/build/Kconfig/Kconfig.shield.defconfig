## nrf5340_audio/build/Kconfig/Kconfig.shield.defconfig
```kconfig
osource "/ncs/v2.2.99-dev3/boards/shields/*/Kconfig.defconfig"
osource "D:/ncs/v2.3.0/nrf/boards/shields/*/Kconfig.defconfig"
```

## nrf5340_audio/build_1/Kconfig/Kconfig.shield
```kconfig
osource "/ncs/v2.2.99-dev3/boards/shields/*/Kconfig.shield"
osource "D:/ncs/v2.3.0/nrf/boards/shields/*/Kconfig.shield"
```
